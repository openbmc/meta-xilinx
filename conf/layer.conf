## conf/layer.conf
```bitbake
# We have a conf and classes directory, add to BBPATH
BBPATH .= ":${LAYERDIR}"

BBFILE_COLLECTIONS += "xilinx-layer"
BBFILE_PATTERN_xilinx-layer = ""
LAYERVERSION_xilinx-layer = "1"
LAYERSERIES_COMPAT_xilinx-layer = "sumo"
```

## meta-zynq7/conf/layer.conf
```bitbake
# We have a conf and classes directory, add to BBPATH
BBPATH .= ":${LAYERDIR}"

# We have recipes-* directories, add to BBFILES
BBFILES += "${LAYERDIR}/recipes-*/*/*.bb \
            ${LAYERDIR}/recipes-*/*/*.bbappend"

BBFILE_COLLECTIONS += "zynq7-layer"
BBFILE_PATTERN_zynq7-layer = "^${LAYERDIR}/"
LAYERVERSION_zynq7-layer = "1"
LAYERSERIES_COMPAT_zynq7-layer = "sumo"
```

## meta-zynq7/conf/machine/include/machine-xilinx-default.inc
```bitbake
# Copyright (C) 2017 Xilinx 
# Released under the MIT license (see COPYING.MIT)

# Default Xilinx BSP Machine settings

MACHINE_FEATURES_BACKFILL_CONSIDERED += "rtc"

# File System Configuration
IMAGE_FSTYPES ?= "tar.gz cpio cpio.gz.u-boot"

PREFERRED_PROVIDER_virtual/kernel ?= "linux-xilinx"

# U-Boot Configuration
PREFERRED_PROVIDER_virtual/bootloader ??= "u-boot-enclustra"
PREFERRED_PROVIDER_virtual/boot-bin ??= "${PREFERRED_PROVIDER_virtual/bootloader}"
PREFERRED_PROVIDER_u-boot ?= "u-boot-enclustra"
PREFERRED_PROVIDER_u-boot-fw-utils ?= "u-boot-fw-utils-enclustra"

UBOOT_BINARY ?= "u-boot.bin"
UBOOT_ELF ?= "u-boot"
UBOOT_ELF_aarch64 ?= "u-boot.elf"

MACHINEOVERRIDES .= ":zynq7"
```

## meta-zynq7/meta-mars-zx3/conf/layer.conf
```bitbake
# We have a conf and classes directory, add to BBPATH
BBPATH .= ":${LAYERDIR}"

# We have recipes-* directories, add to BBFILES
BBFILES += "${LAYERDIR}/recipes-*/*/*.bb \
            ${LAYERDIR}/recipes-*/*/*.bbappend"

BBFILE_COLLECTIONS += "mars-zx3-layer"
BBFILE_PATTERN_mars-zx3-layer = ""
LAYERVERSION_mars-zx3-layer = "1"
LAYERSERIES_COMPAT_mars-zx3-layer = "sumo"
```
